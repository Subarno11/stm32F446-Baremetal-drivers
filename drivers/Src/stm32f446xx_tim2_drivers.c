/*
 * stm32f446xx_tim2_drivers.c
 *
 *  Created on: 06-Jun-2026
 *      Author: Subarno Pal
 */


#include "stm32f446xx.h"

/*********************************************************************
 * @fn      		  - TIM_PeriClockControl
 *
 * @brief             -
 *
 * @param[in]         -
 * @param[in]         -
 * @return            -
 *
 * @Note              -

 */
void TIM_PeriClockControl(TIM_RegDef_t *pTIMx, uint8_t EnorDi){
	if(EnorDi == ENABLE){
		if(pTIMx == TIM2){
			TIM2_PCLK_EN();
		}
	}

	else if(EnorDi == DISABLE){
		if(pTIMx == TIM2){
			TIM2_PCLK_DI();
		}
	}
}
/*********************************************************************
 * @fn      		  - TIM_Init
 *
 * @brief             -
 *
 * @param[in]         -
 * @param[in]         -
 * @return            -
 *
 * @Note              -

 */
void TIM_Init(TIM_Handle_t *pTIMHandle){
	//1. enable the peripheral clock
	TIM_PeriClockControl(pTIMHandle->pTIMx, ENABLE);
	//2. Write into PSC
	pTIMHandle->pTIMx->TIM_PSC = pTIMHandle->TIM_Config.TIM_Prescaler;
	//3. Write into ARR
	pTIMHandle->pTIMx->TIM_ARR = pTIMHandle->TIM_Config.TIM_AutoReload;
	//4. Clear CNT;
	pTIMHandle->pTIMx->TIM_CNT = 0x00;
	//5 . Generate an update event
	pTIMHandle->pTIMx->TIM_EGR |= (1 << TIM2_EGR_UG);
	//6.Clear the UIF flag to remove the stale flag generated by software update event
	TIM2->TIM_SR &= ~(1 << TIM2_SR_UIF);

}


/*********************************************************************
 * @fn      		  - TIM_DeInit
 *
 * @brief             -
 *
 * @param[in]         -
 * @param[in]         -
 * @return            -
 *
 * @Note              -

 */
void TIM_DeInit(TIM_RegDef_t *pTIMx){
	if(pTIMx == TIM2){
		TIM2_REG_RESET();
	}
}


/*********************************************************************
 * @fn      		  - TIM_PeripheralControl
 *
 * @brief             -
 *
 * @param[in]         -
 * @param[in]         -
 * @return            -
 *
 * @Note              -

 */
void TIM_PeripheralControl(TIM_RegDef_t *pTIMx, uint8_t EnorDi){
	if(EnorDi == ENABLE){
		if(pTIMx == TIM2){
			pTIMx->TIM_CR1 |= (1 << TIM2_CR1_CEN);
		}
	}
	else{
		if(pTIMx == TIM2){
			pTIMx->TIM_CR1 &= ~(1 << TIM2_CR1_CEN);
		}
	}
}


/*********************************************************************
 * @fn      		  - TIM_IRQInterruptConfig
 *
 * @brief             -
 *
 * @param[in]         -
 * @param[in]         -
 * @return            -
 *
 * @Note              -

 */
void TIM_IRQInterruptConfig(uint8_t IRQNumber , uint8_t EnorDi){
	if(EnorDi == ENABLE){
		if(IRQNumber <= 31){
			//Program ISER0 register
			*NVIC_ISER0 |= (1<<IRQNumber); //1 = interrupt enabled , 0 = no effect
		}

		else if(IRQNumber > 31 && IRQNumber < 64){
			//Program ISER1 register
			*NVIC_ISER1 |= (1<<IRQNumber % 32); //1 = interrupt enabled , 0 = no effect

		}
		else if(IRQNumber >= 64 && IRQNumber < 96){
			//Program ISER2 register
			*NVIC_ISER2 |= (1<<IRQNumber % 64); //1 = interrupt enabled , 0 = no effect
		}
	}
	else{
		if(IRQNumber <= 31){
			//Program ISER0 register
			*NVIC_ICER0 |= (1<<IRQNumber); //1 = interrupt disabled , 0 = no effect
		}

		else if(IRQNumber > 31 && IRQNumber < 64){
			//Program ISER1 register
			*NVIC_ICER1 |= (1<<IRQNumber % 32); //1 = interrupt disabled , 0 = no effect

		}
		else if(IRQNumber >= 64 && IRQNumber < 96){
			//Program ISER2 register
			*NVIC_ICER2 |= (1<<IRQNumber % 64); //1 = interrupt disabled , 0 = no effect
		}
	}
}

/*********************************************************************
 * @fn      		  - TIM_IRQPriorityConfig
 *
 * @brief             -
 *
 * @param[in]         -
 * @param[in]         -
 * @return            -
 *
 * @Note              -

 */

void TIM_IRQPriorityConfig(uint8_t IRQNumber , uint32_t IRQPriority){
	//1.first lets find out the ipr register
	//Each iprx is 32 bits and is divided into 4 sections each having an IRQ number and each of 8 bit
	uint8_t iprx = IRQNumber/4;
	uint8_t iprx_section = IRQNumber%4;
	uint8_t shift_amount = (8 * iprx_section) + (8- NO_PR_BITS_IMPLEMENTED);
	*(NVIC_PR_BASE_ADDR + iprx) &= ~(0xF <<shift_amount);
	*(NVIC_PR_BASE_ADDR + iprx) |= (IRQPriority << shift_amount);

}

/*********************************************************************
 * @fn      		  - TIM_IRQControl
 *
 * @brief             -
 *
 * @param[in]         -
 * @param[in]         -
 * @return            -
 *
 * @Note              -

 */
void TIM_UpdateInterruptControl(TIM_RegDef_t *pTIMx, uint8_t EnorDi){

	if(EnorDi == ENABLE){
		pTIMx->TIM_DIER |= (1 << TIM2_DIER_UIE);
	}
	else if(EnorDi == DISABLE){
		pTIMx->TIM_DIER &= ~(1 << TIM2_DIER_UIE);
	}
}

/*********************************************************************
 * @fn      		  - TIM_IRQHandling
 *
 * @brief             -
 *
 * @param[in]         -
 * @param[in]         -
 * @return            -
 *
 * @Note              -

 */

void TIM_IRQHandling(TIM_Handle_t *pTIMHandle){
	uint32_t temp1 = pTIMHandle->pTIMx->TIM_SR & (1 << TIM2_SR_UIF);
	uint32_t temp2 = pTIMHandle->pTIMx->TIM_DIER & (1 << TIM2_DIER_UIE);

	if(temp1 && temp2){
		pTIMHandle->pTIMx->TIM_SR &= ~(1 << TIM2_SR_UIF);
		TIM_ApplicationEventCallBack(pTIMHandle , TIM_EVENT_UPDATE);
	}
}

__weak void TIM_ApplicationEventCallBack(TIM_Handle_t *pTIMHandle , uint8_t AppEv){
	//This is a weak implementation to be implemented in the Application Layer

}
